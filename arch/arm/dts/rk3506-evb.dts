/*
 * SPDX-License-Identifier:     GPL-2.0+
 *
 * (C) Copyright 2023 Rockchip Electronics Co., Ltd
 */

/dts-v1/;
#include "rk3506.dtsi"
#include "rk3506-u-boot.dtsi"
#include <dt-bindings/input/input.h>

/ {
	model = "Rockchip RK3506 EVB Board";
	compatible = "rockchip,rk3506-evb", "rockchip,rk3506";

	aliases { serial0 = &uart0; };
  	chosen  { stdout-path = "serial0:1500000n8"; };
};

&uart0 {
  status = "okay";
  u-boot,dm-pre-reloc;
};
