## board/rockchip/evb_rk3506/Kconfig
```kconfig
if TARGET_EVB_RK3506

config SYS_BOARD
	default "evb_rk3506"

config SYS_VENDOR
	default "rockchip"

config SYS_CONFIG_NAME
	default "evb_rk3506"

config BOARD_SPECIFIC_OPTIONS # dummy
	def_bool y

config UART0_AS_SWD_INTERFACE
	bool "Enable UART0 as SWD interface"
	help
	  Enable UART0 pins to function as SWD (Serial Wire Debug) interface.
	  This will configure GPIO0_C6/C7 as JTAG_TCK_M1/JTAG_TMS_M1 and
	  set up the necessary register configurations for SWD functionality.
	  When enabled, UART0 will not be available for normal UART communication.

endif
```
